// SPDX-License-Identifier: (GPL-2.0+ OR MIT)
/*
 * Copyright (c) 2019 BayLibre, SAS.
 * Author: Neil Armstrong <narmstrong@baylibre.com>
 */

#include "meson-gxl-u-boot.dtsi"

/*
 * Move console uart to same header pins as raspberry-pi to support
 * the common console i/o board.
 */
/ {
	aliases {
		serial0 = &uart_A;
		serial1 = &uart_AO;
		ethernet0 = &ethmac;
	};

};

&uart_A {
	status = "okay";
	pinctrl-0 = <&uart_a_pins>;
	pinctrl-names = "default";
};
